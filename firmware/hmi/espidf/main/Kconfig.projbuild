## firmware/hmi/espidf/main/Kconfig.projbuild
```kconfig
menu "PokéDock development features"
config POKEDOCK_HMI_START
    bool "Start EXPERIMENTAL BSP-backed LVGL demo (unverified physical panel)"
    default n
    help
      Off: console-only M0; safe initial firmware skeleton.
      On: initialize Waveshare managed BSP and LVGL and show a basic
      HOME/FOCUS/COUNTDOWN demo. Factory flashing/recovery must be ready;
      this is NOT the final gift UI and no Focus credit is stored to NVS.
endmenu
```

## v16/firmware/idf/main/Kconfig.projbuild
```kconfig
menu "Ghost Companion V16 EXPERIMENTAL"
 config GHOST_V16_ENABLE_OTA
  bool "Enable EXPERIMENTAL manual OTA (NOT PRODUCTION SAFE)"
  default n
  help
   NEVER enable without board bring-up, version and signature checks,
   trusted manifest, app-controlled rollback, and physical power tests.
 config GHOST_V16_UPDATE_BASE
  string "Trusted HTTPS OTA release URL prefix (ends /)"
  default ""
  depends on GHOST_V16_ENABLE_OTA
endmenu
```

## v16/masterball-m6/firmware/main/Kconfig.projbuild
```kconfig
menu "PokeDock M6"
    config PD_SCREEN_ROTATION_180
        bool "Rotate UI 180 degrees (set after checking the mounted board orientation)"
        default n
        help
            The board is mounted with its USB-C pointing down. If the native panel origin
            ends up upside-down on the real unit, enable this; touch is rotated to match.

    choice PD_AUDIO
        prompt "Sound output"
        default PD_AUDIO_DFR0534
        help
            M7 uses the DFRobot DFR0534 MP3 module on header J10 (GPIO44 TX only, board 3V3).
            M6 hardware has the passive buzzer on header J1-8 (IO16, AO3400A driver).
        config PD_AUDIO_DFR0534
            bool "M7: DFRobot DFR0534 MP3 module on J10"
        config PD_AUDIO_BUZZER
            bool "M6: passive buzzer on J1-8 (IO16)"
    endchoice

    config PD_AUDIO_MAX_VOLUME
        int "Highest DFR0534 volume (0-30) allowed by this build"
        depends on PD_AUDIO_DFR0534
        range 0 30
        default 24
        help
            The module runs from the board 3V3 rail (MP1605 buck). Keep 24 until the rail has been
            measured at full volume on the real unit (docs/08, HARDWARE UNVERIFIED).
endmenu
```

## v16/masterball-m6/firmware/sdkconfig.defaults
```kconfig
CONFIG_IDF_TARGET="esp32s3"
CONFIG_ESPTOOLPY_FLASHSIZE_16MB=y
CONFIG_ESPTOOLPY_FLASHMODE_QIO=y
CONFIG_ESPTOOLPY_FLASHFREQ_80M=y
CONFIG_PARTITION_TABLE_CUSTOM=y
CONFIG_PARTITION_TABLE_CUSTOM_FILENAME="partitions.csv"
CONFIG_ESP_DEFAULT_CPU_FREQ_MHZ_240=y
CONFIG_SPIRAM=y
CONFIG_SPIRAM_MODE_OCT=y
CONFIG_SPIRAM_SPEED_80M=y
CONFIG_ESP_CONSOLE_USB_SERIAL_JTAG=y
CONFIG_ESP_MAIN_TASK_STACK_SIZE=8192
CONFIG_FREERTOS_HZ=1000
CONFIG_COMPILER_OPTIMIZATION_PERF=y
# BLE: NimBLE peripheral only, LE Secure Connections, bonds in NVS
CONFIG_BT_ENABLED=y
CONFIG_BT_NIMBLE_ENABLED=y
CONFIG_BT_NIMBLE_ROLE_CENTRAL=n
CONFIG_BT_NIMBLE_ROLE_OBSERVER=n
CONFIG_BT_NIMBLE_ROLE_PERIPHERAL=y
CONFIG_BT_NIMBLE_ROLE_BROADCASTER=y
CONFIG_BT_NIMBLE_MAX_CONNECTIONS=1
CONFIG_BT_NIMBLE_MAX_BONDS=3
CONFIG_BT_NIMBLE_NVS_PERSIST=y
CONFIG_BT_NIMBLE_SM_SC=y
CONFIG_BT_NIMBLE_ATT_PREFERRED_MTU=247
# LVGL 8
CONFIG_LV_COLOR_16_SWAP=y
CONFIG_LV_MEM_CUSTOM=y
CONFIG_LV_MEMCPY_MEMSET_STD=y
CONFIG_LV_FONT_FMT_TXT_LARGE=y
CONFIG_LV_ATTRIBUTE_FAST_MEM_USE_IRAM=y
CONFIG_LV_USE_PERF_MONITOR=n
CONFIG_LV_FONT_MONTSERRAT_14=y
# Wi-Fi is not used (offline device); OTA intentionally absent
```
